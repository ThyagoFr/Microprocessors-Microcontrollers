; Universidade Federal do CearА
; Departamento de Engenharia ElИtrica
; Disciplina : Microprocessadores
; Aluno : Thyago Freitas da Silva
; Parte V do Projeto de LaboratСrio
    
#INCLUDE <P16F628A.INC>

#DEFINE	 CHAVE_MSB   PORTA,0
#DEFINE	 CHAVE_LSB   PORTA,1
#DEFINE	 BOTAO       PORTA,2
    
#DEFINE  MOTOR_ESQ   PORTB,0
#DEFINE  MOTOR_DIR   PORTB,1
#DEFINE  LED	     PORTB,2
    
    
CONT1   EQU 0X21
CONT2   EQU 0X22
CONT3   EQU 0X23

ORG     0x00
    GOTO    INI

ORG     0x04
    RETFIE
    
INI:
  ; DESLIGANDO MODULO COMPARADOR 
    BANKSEL CMCON
    MOVLW   0x07
    MOVWF   CMCON
    
  ; CONFIGURANDO PORTA COMO INPUT ATRAVES DO REGISTRADOR TRISA
    BANKSEL TRISA
    MOVLW   B'00000111'
    MOVWF   TRISA
    
  ; CONFIGURANDO PORTB COMO OUTPUT ATRAVES DO REGISTRADOR TRISB
    BANKSEL TRISB
    MOVLW   0x00
    MOVWF   TRISB
    
  ; CONFIGURACAO INICIAL DOS MOTORES = ATIVO
    BANKSEL PORTB
    CLRF    PORTB  
    
    BANKSEL PORTA
    BSF	    PORTA,3
       
MAIN_X:
    BANKSEL PORTA
    BTFSC   BOTAO              ; SE FOR 1, QUER DIZER QUE UMA LINHA FOI DETECTADA.
    CALL    ANALISE_CURVA_X
    GOTO    MAIN_X

ANALISE_CURVA_X:
    BTFSC   CHAVE_MSB           
    CALL    ANALISE_CURVA_1	; SE CHAVE MSB = 1, ANALISE PARA VER O LSB
    BTFSS   CHAVE_MSB
    CALL    ANALISE_CURVA_0     ; SE CHAVE MSB = 0, ANALISE PARA VER O LSB
    
ANALISE_CURVA_0:
    BTFSC   CHAVE_LSB
    CALL    CURVA_ESQUERDA      ; SE CHAVE LSB = 1, CURVA A ESQUERDA
    BTFSS   CHAVE_LSB
    CALL    CURVA_DIREITA       ; SE CHAVE LSB = 0, CURVA A DIREITA
    GOTO    ANALISE_CURVA_FINAL_0
    
ANALISE_CURVA_1:
    BTFSC   CHAVE_LSB           
    CALL    CURVA_ESQUERDA      ; SE CHAVE LSB = 1, CURVA PRA ESQUERDA
    BTFSS   CHAVE_LSB
    CALL    CURVA_DIREITA       ; SE CHAVE LSB = 0, CURVA PRA DIREITA
    GOTO    ANALISE_CURVA_FINAL_1
    
ANALISE_CURVA_FINAL_0:
    BTFSC   BOTAO
    CALL    CURVA_FINAL_0
    GOTO    ANALISE_CURVA_FINAL_0
    
ANALISE_CURVA_FINAL_1:
    BTFSC   BOTAO
    CALL    CURVA_FINAL_1
    GOTO    ANALISE_CURVA_FINAL_1

CURVA_FINAL_0:
    CALL    CURVA_DIREITA
    GOTO    ESPERAR_FIM
  
CURVA_FINAL_1:
    CALL    CURVA_ESQUERDA
    GOTO    ESPERAR_FIM
    
ESPERAR_FIM:
    BTFSC   BOTAO
    CALL    PARAR
    GOTO    ESPERAR_FIM
   
PARAR:
    BANKSEL PORTB
    BSF	    LED
    BSF	    MOTOR_DIR
    BSF	    MOTOR_ESQ
    GOTO    LOOP_INFINITO
    
LOOP_INFINITO:
    GOTO    LOOP_INFINITO
    
CURVA_DIREITA:
    BANKSEL PORTB
    BSF	    MOTOR_DIR
    CALL    DELAY
    BANKSEL PORTB
    BCF	    MOTOR_DIR
    RETURN
    
CURVA_ESQUERDA:
    BANKSEL PORTB
    BSF	    MOTOR_ESQ
    CALL    DELAY
    BANKSEL PORTB
    BCF	    MOTOR_ESQ
    RETURN

DELAY:
    MOVLW 0X6D
    MOVWF CONT1
    MOVLW 0X5E
    MOVWF CONT2
    MOVLW 0X1A
    MOVWF CONT3
    LOOP
    DECFSZ CONT1, 1
    GOTO LOOP
    DECFSZ CONT2, 1
    GOTO LOOP
    DECFSZ CONT3, 1
    GOTO LOOP
    RETURN

END





