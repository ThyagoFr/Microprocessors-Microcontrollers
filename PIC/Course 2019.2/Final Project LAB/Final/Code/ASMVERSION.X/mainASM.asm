#INCLUDE <P16F628A.INC>
    
;======================== DEFININDO AS PORTAS DOS SENSORES, MOTORES E CHAVES ==================================
#DEFINE MOTORESQUERDO1	     PORTB,0
#DEFINE MOTORESQUERDO2	     PORTB,1
#DEFINE MOTORDIREITO1	     PORTB,2
#DEFINE MOTORDIREITO2	     PORTB,3
#DEFINE LED_FINAL	     PORTB,5
#DEFINE SENSORESQUERDO_EXT   PORTA,0
#DEFINE SENSORESQUERDO_INT   PORTA,7    
#DEFINE SENSORDIREITO_EXT    PORTA,3
#DEFINE SENSORDIREITO_INT    PORTA,2
#DEFINE	CHAVE_MSB	     PORTB,6
#DEFINE	CHAVE_LSB	     PORTB,7
    
;======================== VARIAVEIS DELAY =====================================================================
DCounter1 EQU 0X22
DCounter2 EQU 0X23
DCounter3 EQU 0X24
CONTADOR  EQU 0X25
    
ORG	0x00
    GOTO    CONFIG_INI
ORG	0x04
    RETFIE
    
CONFIG_INI:
    BANKSEL CMCON
    MOVLW   0x07
    MOVWF   CMCON
    
    BANKSEL TRISA
    MOVLW   B'10111111'
    MOVWF   TRISA
    
    BANKSEL TRISB
    MOVLW   B'11000000'
    MOVWF   TRISB
    
    BANKSEL CONTADOR
    MOVLW   B'00000011'
    MOVWF   CONTADOR
    
    CLRF    PORTA
    CLRF    PORTB
    CALL    SEGUE_FRENTE
    
LOOP_PARTE1:
    CALL    SEGUE_FRENTE
    CALL    TESTE_SENSOR_INTERNO_DIREITO
    CALL    TESTE_SENSOR_INTERNO_ESQUERDO
    CALL    TESTE_SENSORES_INTERNOS
    CALL    TESTE_SENSOR_EXT_DIREITO
    CALL    TESTE_SENSOR_EXT_ESQUERDO
    CALL    PARA_RODAS
    BTFSC   CONTADOR,1
    GOTO    LOOP_PARTE1
    CALL    CHECA_FIM
    GOTO    LOOP_PARTE1

INTERMEDIARIO:
    CALL    PARA_RODAS
    CALL    CURVA_180
    BANKSEL CONTADOR
    MOVLW   B'00000011'
    MOVWF   CONTADOR
    
LOOP_PARTE2_MSB:
    CALL    SEGUE_FRENTE
    CALL    TESTE_SENSOR_INTERNO_DIREITO
    CALL    TESTE_SENSOR_INTERNO_ESQUERDO
    CALL    TESTE_SENSOR_ENCRUZILHADA_MSB
    CALL    PARA_RODAS
    GOTO    LOOP_PARTE2_MSB
    
TESTE_SENSOR_ENCRUZILHADA_MSB:
    BTFSS   SENSORDIREITO_EXT
    RETURN
    BTFSS   SENSORESQUERDO_EXT
    RETURN
    BTFSS   CHAVE_MSB
    BTFSC   CHAVE_MSB
    CALL    CURVA_DIREITA_90
    CALL    CURVA_ESQUERDA_90
    GOTO    LOOP_PARTE2_LSB
    
LOOP_PARTE2_LSB:
    CALL    SEGUE_FRENTE
    CALL    TESTE_SENSOR_INTERNO_DIREITO
    CALL    TESTE_SENSOR_INTERNO_ESQUERDO
    CALL    TESTE_SENSOR_ENCRUZILHADA_LSB
    CALL    PARA_RODAS
    GOTO    LOOP_PARTE2_LSB
   
TESTE_SENSOR_ENCRUZILHADA_LSB:
    BTFSS   SENSORDIREITO_EXT
    RETURN
    BTFSS   SENSORESQUERDO_EXT
    RETURN
    BTFSS   CHAVE_LSB
    BTFSC   CHAVE_LSB
    CALL    CURVA_DIREITA_90
    CALL    CURVA_ESQUERDA_90
    GOTO    ESPERA_FIM
  
ESPERA_FIM:
    CALL    TESTE_SENSOR_INTERNO_DIREITO
    CALL    TESTE_SENSOR_INTERNO_ESQUERDO
    CALL    TESTE_SENSOR_ENCRUZILHADA
    GOTO    ESPERA_FIM

TESTE_SENSOR_ENCRUZILHADA:
    BTFSS   SENSORDIREITO_EXT
    RETURN
    BTFSS   SENSORESQUERDO_EXT
    RETURN
    CALL    PARA_RODAS
    BSF	    LED_FINAL
    FIM:
	GOTO	FIM
    
CHECA_FIM:
    BTFSS   SENSORDIREITO_EXT
    RETURN
    BTFSS   SENSORESQUERDO_EXT
    RETURN
    GOTO    INTERMEDIARIO
    
TESTE_SENSOR_EXT_DIREITO:
    BTFSS   SENSORDIREITO_EXT
    RETURN
    CALL    CURVA_DIREITA_90
    DECF    CONTADOR
    RETURN
    
TESTE_SENSOR_EXT_ESQUERDO:
    BTFSS   SENSORESQUERDO_EXT
    RETURN
    CALL    CURVA_ESQUERDA_90
    DECF    CONTADOR
    RETURN
    
TESTE_SENSORES_INTERNOS:
    BTFSC   SENSORDIREITO_INT
    RETURN
    BTFSC   SENSORESQUERDO_INT
    RETURN
    CALL    SEGUE_FRENTE
    RETURN
    
TESTE_SENSOR_INTERNO_DIREITO:
    BTFSS   SENSORDIREITO_INT
    RETURN
    CALL    CURVA_DIREITA
    RETURN
    
TESTE_SENSOR_INTERNO_ESQUERDO:
    BTFSS   SENSORESQUERDO_INT
    RETURN
    CALL    CURVA_ESQUERDA
    RETURN
    
SEGUE_FRENTE:
    BANKSEL PORTB
    BSF	    MOTORDIREITO1
    BCF	    MOTORDIREITO2
    BSF	    MOTORESQUERDO1
    BCF	    MOTORESQUERDO2
    RETURN
 
CURVA_DIREITA:
    BANKSEL PORTB
    BSF	    MOTORDIREITO1
    BSF	    MOTORDIREITO2
    BSF	    MOTORESQUERDO1
    BCF	    MOTORESQUERDO2
    RETURN

CURVA_ESQUERDA:
    BANKSEL PORTB
    BSF	    MOTORESQUERDO1
    BSF	    MOTORESQUERDO2
    BSF	    MOTORDIREITO1
    BCF	    MOTORDIREITO2
    RETURN
    
CURVA_DIREITA_90:
    BANKSEL PORTB
    BSF	    MOTORDIREITO1
    BSF	    MOTORDIREITO2
    CALL    DELAY
    BSF	    MOTORESQUERDO1
    BCF	    MOTORESQUERDO2
    RETURN

CURVA_ESQUERDA_90:
    BANKSEL PORTB
    BSF	    MOTORESQUERDO1
    BSF	    MOTORESQUERDO2
    CALL    DELAY
    BSF	    MOTORDIREITO1
    BCF	    MOTORDIREITO2
    RETURN
    
CURVA_180:
    BSF	    MOTORDIREITO1
    BCF	    MOTORDIREITO2
    BCF	    MOTORESQUERDO1
    BSF	    MOTORESQUERDO2
    CALL    DELAY
    CALL    DELAY
    CALL    SEGUE_FRENTE
    RETURN
    
PARA_RODAS:
    BANKSEL PORTB
    BSF	    MOTORDIREITO1
    BSF	    MOTORDIREITO2
    BSF	    MOTORESQUERDO1
    BSF	    MOTORESQUERDO2
    RETURN
    
DELAY:
    MOVLW 0X54
    MOVWF DCounter1
    MOVLW 0X70
    MOVWF DCounter2
    MOVLW 0X03
    MOVWF DCounter3
    LOOP
    DECFSZ DCounter1, 1
    GOTO LOOP
    DECFSZ DCounter2, 1
    GOTO LOOP
    DECFSZ DCounter3, 1
    GOTO LOOP
    NOP
    RETURN

END