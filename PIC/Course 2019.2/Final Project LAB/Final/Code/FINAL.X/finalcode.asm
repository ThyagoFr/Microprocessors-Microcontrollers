#INCLUDE <P16F628A.INC>
;========================== DECLARAÇÃO DE VARIÁVEIS PARA O DELAY ==============================================
TEMPD1 EQU 0x71
TEMPD2 EQU 0x72
CONTA EQU 0x73
CONTADOR EQU 0x74
CONTADOR_VOLTA EQU 0x75
CONTADOR_AUX EQU 0x76
TEMPO1 EQU 0x77
TEMPO2 EQU 0x78
CONTA_VOLTA EQU 0x79
;======================== CONFIGURAÇÃO DOS FUSES BITS =========================================================
__CONFIG _FOSC_INTOSCIO & _WDTE_OFF & _PWRTE_OFF & _MCLRE_OFF & _BOREN_OFF & _LVP_OFF & _CPD_OFF & _CP_OFF
;======================== DEFININDO AS PORTAS DOS SENSORES, MOTORES E CHAVES ==================================
#DEFINE SENSORE PORTA,0
#DEFINE SENSORD PORTA,1
#DEFINE CHAVE_CAMINHO_MSB PORTA,2
#DEFINE CHAVE_CAMINHO_LSB PORTA,3
#DEFINE LED PORTB,0
#DEFINE LED1 PORTB,1
#DEFINE MOTOR_INV_ESQH PORTB,2
#DEFINE MOTOR_INV_DIRH PORTB,3
#DEFINE CHAVE_MOTOR_E PORTB,4
#DEFINE CHAVE_MOTOR_D PORTB,5
#DEFINE MOTOR_ESQH PORTB,6
#DEFINE MOTOR_DIRH PORTB,7
;======================== INÍCIO DO PROGRAMA =========================================================
ORG 0x00
GOTO INICIO
ORG 0x04
RETFIE
INICIO:
BANKSEL PORTA
MOVLW B'00000000'
MOVWF CONTADOR_AUX
MOVLW B'00000001'
MOVWF CONTADOR
MOVLW B'00000001'
MOVWF CONTADOR_VOLTA
CLRF PORTA
CLRF PORTB
BANKSEL TRISA
MOVLW B'00001111'
MOVWF TRISA
BSF   PORTA,4
MOVLW B'00000000'
MOVWF TRISB
BANKSEL CMCON
MOVLW .7
MOVWF CMCON
BANKSEL PORTA
LIGA_MOTORES:
BSF CHAVE_MOTOR_E
BSF CHAVE_MOTOR_D
TESTE_CURVA_INICIO:
BTFSS CONTADOR,2
GOTO $+2
GOTO PARTE_I
BTFSS SENSORE
GOTO TESTE_SENSOR_DIREITO
GOTO FAZER_CURVA_ESQUERDA
FAZER_CURVA_ESQUERDA:
BCF CHAVE_MOTOR_E
BCF CHAVE_MOTOR_D
BCF MOTOR_ESQH
BSF MOTOR_DIRH
TESTE_FIM_CURVA:
BTFSS CONTADOR_AUX,1
CALL ATRASO
CALL ATRASO
BSF CHAVE_MOTOR_E
BSF CHAVE_MOTOR_D
BCF MOTOR_DIRH
INCF CONTADOR,F
INCF CONTADOR_AUX,F
GOTO TESTE_CURVA_INICIO
TESTE_SENSOR_DIREITO:
BTFSC SENSORD
GOTO TESTE_CURVA_INICIO
BCF CHAVE_MOTOR_E
BCF CHAVE_MOTOR_D
BSF MOTOR_ESQH
BCF MOTOR_DIRH
TESTE_FIM_CURVA1:
BTFSS CONTADOR_AUX,1
CALL ATRASO
CALL ATRASO
BSF CHAVE_MOTOR_E
BSF CHAVE_MOTOR_D
BCF MOTOR_ESQH
INCF CONTADOR,F
INCF CONTADOR_AUX,F
GOTO TESTE_CURVA_INICIO
PARTE_I:
BSF LED
BTFSS SENSORE
GOTO TESTE_GIRO_DIREITO
GOTO GIRO
GIRO:
BCF CHAVE_MOTOR_E
BCF CHAVE_MOTOR_D
BCF MOTOR_ESQH
BSF MOTOR_INV_ESQH
BSF MOTOR_DIRH
CALL ATRASO
CALL ATRASO
CALL ATRASO
BSF CHAVE_MOTOR_E
BSF CHAVE_MOTOR_D
BCF MOTOR_DIRH
BCF MOTOR_INV_ESQH
GOTO PARTE_II
TESTE_GIRO_DIREITO:
BTFSC SENSORD
GOTO PARTE_I
GOTO GIRO
PARTE_II:
BSF LED1
BTFSS CHAVE_CAMINHO_MSB
GOTO CAMINHO_0X
GOTO CAMINHO_1X
CAMINHO_0X:
BTFSS CHAVE_CAMINHO_LSB
GOTO CAMINHO_00
GOTO CAMINHO_01
CAMINHO_1X:
BTFSS CHAVE_CAMINHO_LSB
GOTO CAMINHO_10
GOTO CAMINHO_11
CAMINHO_00:
BTFSS CONTADOR_VOLTA,2
GOTO $+2
GOTO PARTE_III
BTFSS SENSORE
GOTO TESTE_VOLTA_SENSOR_DIREITO
GOTO FAZER_VOLTA_CURVA_ESQUERDA
FAZER_VOLTA_CURVA_ESQUERDA:
BCF CHAVE_MOTOR_E
BCF CHAVE_MOTOR_D
BCF MOTOR_ESQH
BSF MOTOR_INV_ESQH
BSF MOTOR_DIRH
TESTE_VOLTA_FIM_CURVA:
CALL ATRASO
BSF CHAVE_MOTOR_E
BSF CHAVE_MOTOR_D
BCF MOTOR_DIRH
BCF MOTOR_INV_ESQH
INCF CONTADOR_VOLTA,F
GOTO CAMINHO_00
TESTE_VOLTA_SENSOR_DIREITO:
BTFSC SENSORD
GOTO CAMINHO_00
BCF CHAVE_MOTOR_E
BCF CHAVE_MOTOR_D
BCF MOTOR_ESQH
BSF MOTOR_INV_ESQH
BSF MOTOR_DIRH
TESTE_VOLTA_FIM_CURVA1:
CALL ATRASO
BSF CHAVE_MOTOR_E
BSF CHAVE_MOTOR_D
BCF MOTOR_DIRH
BCF MOTOR_INV_ESQH
INCF CONTADOR_VOLTA,F
GOTO CAMINHO_00
CAMINHO_01:
BTFSS CONTADOR_VOLTA,2
GOTO $+2
GOTO PARTE_III
BTFSS SENSORE
GOTO $-1
GOTO FAZER_VOLTA_CURVA_ESQUERDA_01
FAZER_VOLTA_CURVA_ESQUERDA_01:
BCF CHAVE_MOTOR_E
BCF CHAVE_MOTOR_D
BCF MOTOR_ESQH
BSF MOTOR_INV_ESQH
BSF MOTOR_DIRH
TESTE_VOLTA_FIM_CURVA_01:
CALL ATRASO
BSF CHAVE_MOTOR_E
BSF CHAVE_MOTOR_D
BCF MOTOR_DIRH
BCF MOTOR_INV_ESQH
INCF CONTADOR_VOLTA,F
GOTO TESTE_VOLTA_SENSOR_DIREITO_01
TESTE_VOLTA_SENSOR_DIREITO_01:
BTFSC SENSORD
GOTO $-1
BCF CHAVE_MOTOR_E
BCF CHAVE_MOTOR_D
BSF MOTOR_ESQH
BCF MOTOR_DIRH
BSF MOTOR_INV_DIRH
TESTE_VOLTA_FIM_CURVA1_01:
CALL ATRASO
BSF CHAVE_MOTOR_E
BSF CHAVE_MOTOR_D
BCF MOTOR_ESQH
BCF MOTOR_INV_DIRH
INCF CONTADOR_VOLTA,F
GOTO CAMINHO_01
CAMINHO_10:
BTFSS CONTADOR_VOLTA,2
GOTO $+2
GOTO PARTE_III
BTFSC SENSORD
GOTO $-1
GOTO FAZER_VOLTA_CURVA_DIREITA_10
FAZER_VOLTA_CURVA_DIREITA_10:
BCF CHAVE_MOTOR_E
BCF CHAVE_MOTOR_D
BSF MOTOR_ESQH
BSF MOTOR_INV_DIRH
BCF MOTOR_DIRH
TESTE_VOLTA_FIM_CURVA_10:
CALL ATRASO
BSF CHAVE_MOTOR_E
BSF CHAVE_MOTOR_D
BCF MOTOR_ESQH
BCF MOTOR_INV_DIRH
INCF CONTADOR_VOLTA,F
GOTO TESTE_VOLTA_SENSOR_ESQUERDO_10
TESTE_VOLTA_SENSOR_ESQUERDO_10:
BTFSS SENSORE
GOTO $-1
BCF CHAVE_MOTOR_E
BCF CHAVE_MOTOR_D
BCF MOTOR_ESQH
BSF MOTOR_DIRH
BSF MOTOR_INV_ESQH
TESTE_VOLTA_FIM_CURVA1_10:
CALL ATRASO
BSF CHAVE_MOTOR_E
BSF CHAVE_MOTOR_D
BCF MOTOR_DIRH
BCF MOTOR_INV_ESQH
INCF CONTADOR_VOLTA,F
GOTO CAMINHO_10
CAMINHO_11:
BTFSS CONTADOR_VOLTA,2
GOTO $+2
GOTO PARTE_III
BTFSC SENSORD
GOTO TESTE_VOLTA_SENSOR_DIREITO_11
GOTO FAZER_VOLTA_CURVA_DIREITA_11
FAZER_VOLTA_CURVA_DIREITA_11:
BCF CHAVE_MOTOR_E
BCF CHAVE_MOTOR_D
BSF MOTOR_ESQH
BSF MOTOR_INV_DIRH
BCF MOTOR_DIRH
TESTE_VOLTA_FIM_CURVA_11:
CALL ATRASO
BSF CHAVE_MOTOR_E
BSF CHAVE_MOTOR_D
BCF MOTOR_ESQH
BCF MOTOR_INV_DIRH
INCF CONTADOR_VOLTA,F
GOTO CAMINHO_11
TESTE_VOLTA_SENSOR_DIREITO_11:
BTFSS SENSORE
GOTO CAMINHO_11
BCF CHAVE_MOTOR_E
BCF CHAVE_MOTOR_D
BSF MOTOR_ESQH
BSF MOTOR_INV_DIRH
BCF MOTOR_DIRH
TESTE_VOLTA_FIM_CURVA1_11:
CALL ATRASO
BSF CHAVE_MOTOR_E
BSF CHAVE_MOTOR_D
BCF MOTOR_ESQH
BCF MOTOR_INV_DIRH
INCF CONTADOR_VOLTA,F
GOTO CAMINHO_11
GOTO PARTE_II
PARTE_III:
BCF CHAVE_MOTOR_E
BCF CHAVE_MOTOR_D
BCF MOTOR_ESQH
BCF MOTOR_DIRH
BCF MOTOR_INV_ESQH
BCF MOTOR_INV_DIRH
BCF LED1
GOTO PARTE_III
ATRASO:
MOVLW .255
MOVWF TEMPD1
MOVWF TEMPD2
MOVLW .2; ANTES ERA 4; 3 PARA 0.2 s ; 6 PARA 0.5 s
MOVWF CONTA
AUX:
DECFSZ TEMPD1
GOTO AUX
DECFSZ TEMPD2
GOTO AUX
DECFSZ CONTA
GOTO AUX
RETURN
END


